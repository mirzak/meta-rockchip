## conf/machine/evb-rv1108.conf
```bitbake
# Copyright (C) 2017 Fuzhou Rockchip Electronics Co., Ltd
# Released under the MIT license (see COPYING.MIT for the terms)

#@TYPE: Machine
#@NAME: EVB RV1108
#@DESCRIPTION: Machine configuration for RV1108 evalution board
#@SOC: RV1108
#@HOMEPAGE: Unknown
#@MAINTAINER: Unknown

include conf/machine/include/rv1108.inc

KERNEL_DEVICETREE = "rv1108-evb.dtb"
UBOOT_MACHINE = "evb-rk3288_defconfig"
```

## conf/machine/excavator-rk3399.conf
```bitbake
# Copyright (C) 2017 Fuzhou Rockchip Electronics Co., Ltd
# Released under the MIT license (see COPYING.MIT for the terms)

#@TYPE: Machine
#@NAME: EXCAVATOR RK3399
#@DESCRIPTION: Machine configuration for Excavator Sapphire evalution board
#@SOC: RK3399
#@HOMEPAGE: http://opensource.rock-chips.com/wiki_Excavator_sapphire_board
#@MAINTAINER: Unknown

include conf/machine/include/rk3399.inc

KERNEL_DEVICETREE = "rockchip/rk3399-sapphire-excavator-linux.dtb"
UBOOT_MACHINE = "evb-rk3399_defconfig"
```

## conf/machine/fennec-rk3288.conf
```bitbake
# Copyright (C) 2017 Fuzhou Rockchip Electronics Co., Ltd
# Released under the MIT license (see COPYING.MIT for the terms)

#@TYPE: Machine
#@NAME: FENNEC RK3288
#@DESCRIPTION: Machine configuration for Fennec evalution board
#@SOC: RK3288
#@HOMEPAGE: Unknown
#@MAINTAINER: Unknown

include conf/machine/include/rk3288.inc

KERNEL_DEVICETREE = "rk3288-fennec.dtb"
UBOOT_MACHINE = "fennec-rk3288_defconfig"
```

## conf/machine/firefly-rk3288.conf
```bitbake
# Copyright (C) 2015 Romain Perier
# Released under the MIT license (see COPYING.MIT for the terms)

#@TYPE: Machine
#@NAME: Firefly RK3288
#@DESCRIPTION: Machine configuration for Firefly-RK3288
#@SOC: RK3288
#@HOMEPAGE: http://en.t-firefly.com/en/firenow/firefly_rk3288/
#@MAINTAINER: Mirza Krak <mirza.krak@endian.se>

include conf/machine/include/rk3288.inc

KERNEL_DEVICETREE = "rk3288-firefly.dtb"
UBOOT_MACHINE = "firefly-rk3288_defconfig"
```

## conf/machine/firefly-rk3399.conf
```bitbake
# Copyright (C) 2017 Fuzhou Rockchip Electronics Co., Ltd
# Released under the MIT license (see COPYING.MIT for the terms)

#@TYPE: Machine
#@NAME: Firefly RK3399
#@DESCRIPTION: Machine configuration for Firefly-RK3399
#@SOC: RK3399
#@HOMEPAGE: http://en.t-firefly.com/en/firenow/Firefly_RK3399/
#@MAINTAINER: Unknown

include conf/machine/include/rk3399.inc

KERNEL_DEVICETREE = "rockchip/rk3399-firefly-linux.dtb"
UBOOT_MACHINE = "firefly-rk3399_defconfig"
```

## conf/machine/phycore-rk3288.conf
```bitbake
# Copyright (C) 2016 Wadim Egorov
# Released under the MIT license (see COPYING.MIT for the terms)

#@TYPE: Machine
#@NAME: phyCORE RK3288 RDK
#@DESCRIPTION: Machine configuration for phyCORE-RK3288 Rapid Development Kit
#@SOC: RK3288
#@HOMEPAGE: http://www.phytec.eu/product/system-on-modules/phycore-rk3288/
#@MAINTAINER: Unknown

include conf/machine/include/rk3288.inc

KERNEL_DEVICETREE = "rk3288-phycore-rdk.dtb"
UBOOT_MACHINE = "phycore-rk3288_defconfig"
```

## conf/machine/radxarock.conf
```bitbake
# Copyright (C) 2014 NEO-Technologies
# Copyright (C) 2015 Romain Perier
# Released under the MIT license (see COPYING.MIT for the terms)

#@TYPE: Machine
#@NAME: Radxa Rock
#@DESCRIPTION: Machine configuration for Radxa Rock (Pro/Lite)
#@SOC: RK3188
#@HOMEPAGE: http://wiki.radxa.com/Rock
#@MAINTAINER: Unknown

require conf/machine/include/rk3188.inc

KERNEL_DEVICETREE = "rk3188-radxarock.dtb"
UBOOT_MACHINE = "rock_defconfig"
```

## conf/machine/rock2-square.conf
```bitbake
# Copyright (C) 2016 Romain Perier
# Released under the MIT license (see COPYING.MIT for the terms)

#@TYPE: Machine
#@NAME: Radxa Rock2 Square
#@DESCRIPTION: Machine configuration for Radxa Rock2 Square SBC
#@SOC: RK3288
#@HOMEPAGE: http://wiki.radxa.com/Rock2
#@MAINTAINER: Unknown

include conf/machine/include/rk3288.inc

KERNEL_DEVICETREE = "rk3288-rock2-square.dtb"
UBOOT_MACHINE = "rock2_defconfig"
```

## conf/machine/tinker-rk3288.conf
```bitbake
# Copyright (C) 2017 Fuzhou Rockchip Electronics Co., Ltd
# Released under the MIT license (see COPYING.MIT for the terms)

#@TYPE: Machine
#@NAME: Tinker RK3288
#@DESCRIPTION: Machine configuration for Asus Tinkerboard (Raspberrypi clone)
#SOC: RK3288
#@HOMEPAGE: https://www.asus.com/uk/Single-Board-Computer/Tinker-Board/
#@MAINTAINER: Mirza Krak <mirza.krak@endian.se>

include conf/machine/include/rk3288.inc

PREFERRED_PROVIDER_virtual/kernel ?= "linux-tinker"

KBUILD_DEFCONFIG = "miniarm-rk3288_defconfig"

KERNEL_DEVICETREE = "rk3288-miniarm.dtb"
UBOOT_MACHINE = "tinker-rk3288_defconfig"
```
